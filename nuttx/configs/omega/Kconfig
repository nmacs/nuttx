## nuttx/configs/omega/Kconfig
```kconfig
#
# For a description of the syntax of this configuration file,
# see misc/tools/kconfig-language.txt.
#

if ARCH_BOARD_OMEGA
config SAM34_METROLOGY
	bool "Metrology support"
	default n
	depends on ARCH_CHIP_SAM4CM

config SAM_BOOTARGS
	bool "Support of passing boot arguments"
	default n

config SAM_BOOTLOADER
	bool "Able to start from bootloader"
	default n

config SAM_LOADER
	bool "Firmware switch"
	default n
	select SAM_BOOTLOADER

config SAM_KEXEC
	bool "Enable kernel switch kexec function"
	default n

endif
```

## nuttx/crypto/Kconfig
```kconfig
#
# For a description of the syntax of this configuration file,
# see misc/tools/kconfig-language.txt.
#

config CRYPTO
	bool "Crypto API support"
	default n
	---help---
	  Enable or disable Crypto API features

if CRYPTO

config CRYPTO_AES
	bool "AES cypher support"
	default n

config CRYPTO_XEX
	bool "XEX mode support"
	default n
	depends on CRYPTO_AES

config CRYPTO_ALGTEST
	bool "Perform automatic crypto algorithms test on startup"
	default n

config CRYPTO_CRYPTODEV
	bool "cryptodev support"
	default n

endif
```

## nuttx/drivers/bch/Kconfig
```kconfig
#
# For a description of the syntax of this configuration file,
# see misc/tools/kconfig-language.txt.
#

config BCH_ENCRIPTION
	bool "Enable encryption feature"
	default n
	depends on CRYPTO_AES

config BCH_ENCRIPTION_KEY_SIZE
  int "AES key size"
  default 16
  depends on BCH_ENCRIPTION
```

## nuttx/fs/fixfs/Kconfig
```kconfig
#
# For a description of the syntax of this configuration file,
# see misc/tools/kconfig-language.txt.
#

config FS_FIXFS
	bool "FIXFS File System"
	default n
	select FS_READABLE
	select FS_WRITABLE
	select BCH

if FS_FIXFS

endif
```

## nuttx/libcoap/Kconfig
```kconfig
#
# For a description of the syntax of this configuration file,
# see misc/tools/kconfig-language.txt.
#

comment "C-Implementation of CoAP"

menuconfig LIB_COAP
	bool "C-Implementation of CoAP"
	default n

config LIB_COAP_MAX_RESOURCES
	int "Maximun number of CoAP resources"
	default 16
	depends on LIB_COAP

config LIB_COAP_MAX_ATTRIBUTES
	int "Maximun number of CoAP attributes"
	default 16
	depends on LIB_COAP

config LIB_COAP_MAX_SUBSCRIBERS
	int "Maximun number of CoAP subscribers"
	default 0
	depends on LIB_COAP

config LIB_COAP_MAX_PDU_SIZE
	int "Maximum size of a CoAP PDU"
	default 128
	depends on LIB_COAP

config LIB_COAP_PDU_MAXCNT
	int "Maximum number of CoAP PDUs"
	default 3
	depends on LIB_COAP

config LIB_COAP_RESOURCES_NOHASH
	bool "CoAP Resources no hash"
	default n
	depends on LIB_COAP

config LIB_COAP_WITHOUT_ASYNC
	bool "Disable async feature"
	default n
	depends on LIB_COAP

config LIB_COAP_WITHOUT_OBSERVE
	bool "Disable observe feature"
	default n
	depends on LIB_COAP

config LIB_COAP_WITH_MEMB
	bool "Enable static memory allocator"
	default n
	depends on LIB_COAP
```
